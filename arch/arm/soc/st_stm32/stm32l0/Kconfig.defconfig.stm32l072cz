## arch/arm/soc/st_stm32/stm32l0/Kconfig.defconfig.stm32l072cz
```kconfig
# Kconfig - ST Microelectronics STM32L072XB MCU
#
# Copyright (c) 2017 BayLibre, SAS
#
# SPDX-License-Identifier: Apache-2.0
#

if SOC_STM32L072CZ

config SOC
	string
	default stm32l072cz

config FLASH_PAGE_SIZE
	hex
	default 0x800

config NUM_IRQS
	int
	default 32

endif # SOC_STM32L072CZ
```

## arch/arm/soc/st_stm32/stm32l0/Kconfig.soc
```kconfig
# Kconfig - ST Microelectronics STM32L0 MCU line
#
# Copyright (c) 2016 Open-RnD Sp. z o.o.
# Copyright (c) 2016 BayLibre, SAS
#
# SPDX-License-Identifier: Apache-2.0
#

choice
prompt "STM32L0x MCU Selection"
depends on SOC_SERIES_STM32L0X

config SOC_STM32L072CZ
	bool "STM32L072CZ"

endchoice
```

## boards/arm/dragino_lsn50/Kconfig.board
```kconfig
# Kconfig - STM32F072-EVAL board configuration
#
# Copyright (c) 2017 BayLibre, SAS
#
# SPDX-License-Identifier: Apache-2.0
#

config BOARD_DRAGINO_LSN50
	bool "Dragino LSN50 Sensor"
	depends on SOC_STM32L072CZ
```

## boards/arm/dragino_lsn50/Kconfig.defconfig
```kconfig
# Kconfig - STM32F072-EVAL board configuration
#
# Copyright (c) 2017 BayLibre, SAS
#
# SPDX-License-Identifier: Apache-2.0
#

if BOARD_DRAGINO_LSN50

config BOARD
	default dragino_lsn50

if UART_CONSOLE

config UART_STM32_PORT_2
	default y

endif # UART_CONSOLE

endif # BOARD_DRAGINO_LSN50
```

## boards/arm/particle_boron/Kconfig.board
```kconfig
# Kconfig - Particle Xenon configuration
#
# Copyright (c) 2018 Endre Karlson
#
# SPDX-License-Identifier: Apache-2.0

config  BOARD_PARTICLE_BORON
	bool "Particle Boron Board"
	depends on SOC_NRF52840_QIAA
```

## boards/arm/particle_boron/Kconfig.defconfig
```kconfig
# Kconfig - Endre Karlson configuration
#
# Copyright (c) 2018 Endre Karlson
#
# SPDX-License-Identifier: Apache-2.0

if BOARD_PARTICLE_BORON

config BOARD
	default "particle_boron"

config I2C
	default y

if I2C

config I2C_NRFX
	default y

if I2C_NRFX

config I2C_0
	default y

config I2C_1
	default n

endif #I2C_NRFX

if I2C_0

choice I2C_0_NRF_TYPE
	default I2C_0_NRF_TWIM

endchoice

endif # I2C_0

if I2C_1

choice I2C_1_NRF_TYPE
	default I2C_1_NRF_TWIM

endchoice

endif # I2C_1

endif # I2C

if USB

config USB_NRF52840
	default y

config USB_DEVICE_STACK
	default y

endif # USB

if IEEE802154

config IEEE802154_NRF5
	default y

endif # IEEE802154

endif # BOARD_PARTICLE_BORON
```

## subsys/lora/Kconfig
```kconfig
# Kconfig - LoRa configuration options
#
# Copyright (c) 2018 Ding Tao
#
# SPDX-License-Identifier: Apache-2.0
#

menu "LoRa"

config LORA
	bool "Lora Radio support [Experimental]"
	help
	  This option enables LoRa support.

if LORA

source "subsys/lora/radio/Kconfig"
source "subsys/lora/class/Kconfig"

endif # LORA

endmenu
```

## subsys/lora/class/Kconfig
```kconfig
# Kconfig - LoRa radio frequency configuration options
#
# Copyright (c) 2018 Ding Tao
#
# SPDX-License-Identifuer: Apache-2.0
#

choice
	prompt "LoRa radio frequency selection"
	default LORA_REGION_CN470

config LORA_REGION_AS923
	bool "AS923"

config LORA_REGION_AU915
	bool "AS915"

config LORA_REGION_CN470
	bool "CN470"

config LORA_REGION_CN779
	bool "CN779"

config LORA_REGION_EU433
	bool "EU433"

config LORA_REGION_EU868
	bool "EU868"

config LORA_REGION_IN865
	bool "IN865"

config LORA_REGION_KR920
	bool "KR920"

config LORA_REGION_US915
	bool "US915"

config LORA_REGION_US915_HYBRID
	bool "US915-Hybird"

endchoice
```
